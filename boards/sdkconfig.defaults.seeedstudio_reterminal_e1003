## boards/sdkconfig.defaults.seeedstudio_reterminal_e1003
```kconfig
# Seeed Studio reTerminal E1003 Specifics
CONFIG_BOARD_DRIVER_SEEEDSTUDIO_RETERMINAL_E1003=y

# Flash Configuration (32MB with 80MHz QIO)
CONFIG_ESPTOOLPY_FLASHSIZE_32MB=y
CONFIG_ESPTOOLPY_FLASHSIZE="32MB"
CONFIG_ESPTOOLPY_FLASHFREQ_80M=y

# Internal flash storage (LittleFS)
CONFIG_USE_INTERNAL_FLASH_STORAGE=y

# Note: OPI PSRAM (needed for the IT8951 1872x1404 4bpp framebuffer, ~1.3 MB)
# is enabled globally in sdkconfig.defaults.
```

## boards/sdkconfig.defaults.seeedstudio_reterminal_e1004
```kconfig
# Seeed Studio reTerminal E1004 Specifics
CONFIG_BOARD_DRIVER_SEEEDSTUDIO_RETERMINAL_E1004=y

# Flash Configuration (32MB with 80MHz QIO)
CONFIG_ESPTOOLPY_FLASHSIZE_32MB=y
CONFIG_ESPTOOLPY_FLASHSIZE="32MB"
CONFIG_ESPTOOLPY_FLASHFREQ_80M=y

# Internal flash storage (LittleFS)
CONFIG_USE_INTERNAL_FLASH_STORAGE=y
```

## boards/sdkconfig.defaults.waveshare_photopainter_73
```kconfig
# WaveShare 7.3 Inch Specifics
CONFIG_BOARD_DRIVER_WAVESHARE_PHOTOPAINTER_73=y

# Flash Configuration
CONFIG_ESPTOOLPY_FLASHSIZE_16MB=y
CONFIG_ESPTOOLPY_FLASHSIZE="16MB"

CONFIG_PM_TRACE=y
```

## components/axpPower/Kconfig
```kconfig
menu "AXP Power Management"

    config PMIC_DRIVER_AXP2101
        bool
        default n
        help
            Selected by board drivers that require AXP2101 PMIC support.

endmenu
```

## components/board_hal/Kconfig
```kconfig
menu "Board Configuration"

    choice BOARD_TYPE
        prompt "Board Driver"
        default BOARD_DRIVER_WAVESHARE_PHOTOPAINTER_73
        help
            Select the power management driver to use.

        config BOARD_DRIVER_WAVESHARE_PHOTOPAINTER_73
            bool "WaveShare PhotoPainter 7.3in"
            select PMIC_DRIVER_AXP2101
            select SDCARD_DRIVER_SDIO
            select SENSOR_DRIVER_SHTC3
            select RTC_DRIVER_PCF85063
            select EP_DRIVER_ED2208_GCA
            help
                Driver for WaveShare PhotoPainter 7.3in (Spectra 6) board.
                Includes AXP2101 PMIC initialization and SHTC3 sensor sleep management.
                SD card: SDIO interface (4-bit mode).

        config BOARD_DRIVER_SEEEDSTUDIO_XIAO_EE02
            bool "Seeed XIAO EE02 (BQ24070)"
            select EP_DRIVER_ED2208_NCA
            help
                Driver for Seeed Studio XIAO EE02 board.
                Uses BQ24070 Linear Charger.
                Voltage is read via ADC. Percentage is estimated.
                Charging status via GPIO.
                No SD card support.
                AI rotation mode disabled due to limited PSRAM.

        config BOARD_DRIVER_SEEEDSTUDIO_XIAO_EE04
            bool "Seeed XIAO EE04 (7.3in Spectra 6)"
            select EP_DRIVER_ED2208_GCA
            help
                Driver for Seeed Studio XIAO EE04 board (7.3" 6-color).
                Uses BQ24070 Linear Charger.
                Voltage is read via ADC. Percentage is estimated.
                Charging status via GPIO.
                No SD card support.
                AI rotation mode disabled due to limited PSRAM.

        config BOARD_DRIVER_SEEEDSTUDIO_RETERMINAL_E1002
            bool "Seeed reTerminal E1002 (Spectra E6)"
            select SDCARD_DRIVER_SPI
            select SENSOR_DRIVER_SHT40
            select RTC_DRIVER_PCF8563
            select EP_DRIVER_ED2208_GCA
            help
                Driver for Seeed reTerminal E1002 with 7.3" Spectra E6 display.
                Includes battery monitoring and deep sleep support.
                SD card: SPI interface.

        config BOARD_DRIVER_SEEEDSTUDIO_RETERMINAL_E1004
            bool "Seeed reTerminal E1004 (13.3in Spectra 6)"
            select SDCARD_DRIVER_SPI
            select SENSOR_DRIVER_SHT40
            select RTC_DRIVER_PCF8563
            select EP_DRIVER_ED2208_GCA
            help
                Driver for Seeed reTerminal E1004 with 13.3" Spectra 6 display (ED2208).
                Features ESP32-S3R8 (8MB Octal PSRAM), SY6974B I2C charger, PCF8563M RTC,
                SHT40 temperature/humidity sensor, SD card with TPS22916 power gating,
                buzzer, status LED, 3 physical buttons, 3 I2C touch buttons, and
                dual I2C buses. Battery ADC via GPIO1 with TPS22916 load switch.
                SD card: SPI interface.

    endchoice

    config USE_INTERNAL_FLASH_STORAGE
        bool "Use internal flash as storage (LittleFS)"
        default y if BOARD_DRIVER_SEEEDSTUDIO_XIAO_EE02 || BOARD_DRIVER_SEEEDSTUDIO_XIAO_EE04 || BOARD_DRIVER_SEEEDSTUDIO_RETERMINAL_E1002 || BOARD_DRIVER_SEEEDSTUDIO_RETERMINAL_E1004
        default n
        help
            Mounts a LittleFS partition from internal flash to use as storage.
            Disable this if your board has limited flash space (e.g. 4MB)
            and you don't have enough space for a storage partition.
            If disabled, the system will use a small RAM-based filesystem (MemFS)
            for temporary image processing instead.

endmenu
```

## components/epaper_driver_ed2208_nca/Kconfig
```kconfig
config EP_DRIVER_ED2208_NCA
    bool "E-Ink ED2208-NCA (Spectra 6 1200x1600)"
    help
        Driver for 13.3 inch Spectra 6 E-Paper displays (compatible with SeeedStudio T133A01).
```

## components/epaper_driver_el073tf1u5/Kconfig
```kconfig
config EP_DRIVER_EL073TF1U5
    bool "E-Ink EL073TF1U5 (Spectra 6 800x480)"
    help
        Driver for 7.3 inch Spectra 6 E-Paper displays from e-ink holdings (compatible with Waveshare, Seeed reTerminal E1002).
```

## components/epaper_driver_el133uf1/Kconfig
```kconfig
config EP_DRIVER_EL133UF1
    bool "E-Ink EL133UF1 (Spectra 6 1200x1600)"
    help
        Driver for 13.3 inch Spectra 6 E-Paper displays from e-ink holdings (compatible with SeeedStudio T133A01)
```

## components/epaper_driver_it8951/Kconfig
```kconfig
config EP_DRIVER_IT8951
    bool "E-Ink IT8951 controller (grayscale, e.g. reTerminal E1003)"
    help
        Driver for IT8951-based grayscale e-paper panels (16-level / GC16),
        such as the Seeed reTerminal E1003 (10.3" ED103TC2, 1872x1404). The
        IT8951 T-CON drives the panel + TPS65185 PMIC internally; the ESP32
        talks to it over SPI (CS/RST/HRDY) and streams 4bpp gray data.
```

## components/epaper_port/Kconfig
```kconfig
menu "E-Paper Display Configuration"

    config EP_DRIVER_SPECTRA_E6
        bool "Spectra E6 (7.3 Inch: Waveshare/reTerminal)"
        help
            Driver for 7.3 inch Spectra 6 E-Paper displays (Waveshare, Seeed reTerminal E1002).
            This board typically includes an AXP2101 PMIC and/or SD Card slot.

    config EP_DRIVER_SEEEDSTUDIO_T133A01
        bool "Seeed XIAO EE02 (13.3 Inch)"
        help
            Driver for Seeed Studio XIAO EE02 board with 13.3 inch Spectra 6 display.
            This board does NOT have an AXP PMIC or SD Card slot.

endmenu
```

## components/pcf85063_rtc/Kconfig
```kconfig
config RTC_DRIVER_PCF85063
    bool "PCF85063 RTC"
    help
        Enable support for PCF85063 real-time clock.
```

## components/pmic_driver_sy6974b/Kconfig
```kconfig
menu "SY6974B Power Management"

    config PMIC_DRIVER_SY6974B
        bool
        default n
        help
            Selected by board drivers that require SY6974B PMIC support.

endmenu
```

## components/sdcard/Kconfig
```kconfig
config HAS_SDCARD
    bool
    default n
    help
        Automatically enabled when an SD card driver is selected.
        This flag is used to conditionally compile SD card-related code.

config SDCARD_DRIVER_SDIO
    bool "SDIO SD Card Driver"
    select HAS_SDCARD
    help
        Use SDIO interface for SD card (4-bit mode).
        Typically used on boards with dedicated SDMMC pins.

        This is automatically selected by board drivers that use SDIO.

config SDCARD_DRIVER_SPI
    bool "SPI SD Card Driver"
    select HAS_SDCARD
    help
        Use SPI interface for SD card.
        More flexible pin assignment but slower than SDIO.

        This is automatically selected by board drivers that use SPI.

menu "Internal Storage Configuration"

    config USE_INTERNAL_FLASH_STORAGE
        bool "Use internal flash as storage (LittleFS)"
        default y if BOARD_DRIVER_SEEEDSTUDIO_XIAO_EE02 || BOARD_DRIVER_SEEEDSTUDIO_XIAO_EE04 || BOARD_DRIVER_SEEEDSTUDIO_RETERMINAL_E1002
        default n
        help
            Mounts a LittleFS partition from internal flash to use as storage.
            Disable this if your board has limited flash space (e.g. 4MB)
            and you don't have enough space for a storage partition.
            If disabled, the system will use a small RAM-based filesystem (MemFS)
            for temporary image processing instead.


endmenu
```

## components/sht40_sensor/Kconfig
```kconfig
config SENSOR_DRIVER_SHT40
    bool
    default n
    help
        SHT40 temperature and humidity sensor support.
        Selected by board drivers that use SHT40 sensor.
```

## components/shtc3_sensor/Kconfig
```kconfig
config SENSOR_DRIVER_SHTC3
    bool "SHTC3 Sensor"
    help
        Enable support for SHTC3 temperature and humidity sensor.
```

## main/Kconfig.projbuild
```kconfig
menu "Internal Storage Configuration"

    config USE_INTERNAL_FLASH_STORAGE
        bool "Use internal flash as storage (LittleFS)"
        default y
        help
            Mounts a LittleFS partition from internal flash to use as storage.
            Disable this if your board has limited flash space (e.g. 4MB)
            and you don't have enough space for a storage partition.
            If disabled, the system will use a small RAM-based filesystem (MemFS) 
            for temporary image processing instead.

    choice BOARD_FLASH_SIZE
        prompt "Board Total Flash Size"
        depends on USE_INTERNAL_FLASH_STORAGE
        default FLASH_SIZE_16MB
        help
            Select the total physical flash memory size of your board.
            This determines how much space is dedicated for the LittleFS storage partition.
            Ensure you select the correct size, otherwise the firmware may fail to boot.

        config FLASH_SIZE_128MB
            bool "128MB Flash (approx. 120MB for photos)"
            help
                For boards with a huge 128MB Flash.
                Provides a massive ~120MB storage partition for photos.

        config FLASH_SIZE_64MB
            bool "64MB Flash (approx. 56MB for photos)"
            help
                For boards with a massive 64MB Flash.
                Provides a huge ~56MB storage partition for photos.

        config FLASH_SIZE_32MB
            bool "32MB Flash (approx. 24MB for photos)"
            help
                For boards with 32MB Flash. 
                Provides a very large ~24MB storage partition for photos.

        config FLASH_SIZE_16MB
            bool "16MB Flash (approx. 8MB for photos)"
            help
                For boards with 16MB Flash. (App takes ~3.5MB x 2 + System partitions)
                Provides an ~8MB storage partition, allowing substantial photo storage.

        config FLASH_SIZE_8MB
            bool "8MB Flash (approx. 2.8MB for photos)"
            help
                For boards with 8MB Flash. (App takes ~2.5MB x 2 + System partitions)
                Provides a limited ~2.8MB storage partition. Good for OTA and a few photos.
    endchoice

    config INTERNAL_STORAGE_PARTITION_TABLE
        string
        default "partitions/partitions_128mb.csv" if FLASH_SIZE_128MB
        default "partitions/partitions_64mb.csv" if FLASH_SIZE_64MB
        default "partitions/partitions_32mb.csv" if FLASH_SIZE_32MB
        default "partitions/partitions_16mb.csv" if FLASH_SIZE_16MB
        default "partitions/partitions_8mb.csv" if FLASH_SIZE_8MB
        default "partitions/partitions_disable.csv" if !USE_INTERNAL_FLASH_STORAGE

endmenu
```

## sdkconfig.defaults
```kconfig
# ESP32-S3 Configuration
CONFIG_IDF_TARGET="esp32s3"

# Flash Configuration
CONFIG_ESPTOOLPY_FLASHSIZE_16MB=y
CONFIG_ESPTOOLPY_FLASHSIZE="16MB"
CONFIG_ESPTOOLPY_FLASHMODE_QIO=y

# WiFi Configuration
CONFIG_ESP_WIFI_SSID=""
CONFIG_ESP_WIFI_PASSWORD=""
CONFIG_ESP_MAXIMUM_RETRY=5

# HTTP Server Configuration
CONFIG_HTTPD_MAX_REQ_HDR_LEN=1024
CONFIG_HTTPD_MAX_URI_LEN=512

# PSRAM Configuration
CONFIG_SPIRAM=y
CONFIG_SPIRAM_MODE_OCT=y
CONFIG_SPIRAM_SPEED_80M=y
CONFIG_SPIRAM_USE_MALLOC=y

# Partition Table
CONFIG_PARTITION_TABLE_CUSTOM=y
CONFIG_PARTITION_TABLE_CUSTOM_FILENAME="partitions.csv"

# SD Card Configuration
CONFIG_FATFS_LFN_HEAP=y
CONFIG_FATFS_MAX_LFN=255

# FreeRTOS
CONFIG_FREERTOS_HZ=1000

# Component config
CONFIG_LWIP_MAX_SOCKETS=16

# Enable deep sleep
CONFIG_ESP_SLEEP_POWER_DOWN_FLASH=y
CONFIG_ESP_SLEEP_RTC_BUS_ISO_WORKAROUND=y

# Log level
CONFIG_LOG_DEFAULT_LEVEL_INFO=y

# Interrupt Watchdog - Increase timeout for long SPI transfers during e-paper refresh
# Default is 300ms, increase to 1000ms to allow large SPI buffer transfers
CONFIG_ESP_INT_WDT_TIMEOUT_MS=1000

# Task Watchdog - Increase timeout for slow SD card writes during image conversion
# Default is 5 seconds, increase to 15 seconds to allow for slow SD card operations
CONFIG_ESP_TASK_WDT_TIMEOUT_S=15

# Power Management - Enable automatic light sleep and CPU frequency scaling
CONFIG_PM_ENABLE=y
CONFIG_FREERTOS_USE_TICKLESS_IDLE=y
CONFIG_PM_DFS_INIT_AUTO=y
CONFIG_PM_TRACE=y
CONFIG_USJ_NO_AUTO_LS_ON_CONNECTION=y
```

## sdkconfig.defaults.seeedstudio_reterminal_e1002
```kconfig
# Seeed Studio reTerminal E1002 Specifics
CONFIG_BOARD_DRIVER_SEEEDSTUDIO_RETERMINAL_E1002=y
```
